
/dts-v1/;
/plugin/;

/ {
  compatible = "brcm,bcm2708";

  fragment@0 {
    target = <&pwm>;
    __overlay__ {
        // We use our own driver name here to steal it from the kernel driver
        compatible = "xulne,rgbw-strip";
        pinctrl-names = "default";
        pinctrl-0 = <&rgbw_strip_pins>;
        // 106 Leds per strip on my lamp
        num-leds = <848>;
        // On reset, set first 10 leds to (r:0, g:0, b:0, w:100) 
        reset-color = <0 0 0 100 10>;
        assigned-clock-rates = <3333333>;
        dmas = <&dma 5>;
        dma-names = "fifo-dma";
        status = "okay";
    };
  };

  fragment@1 {
    target = <&gpio>;
    __overlay__ {
      rgbw_strip_pins: rgbw_strip_pins {
        // We need one pin, the PWM one
        brcm,pins = <18>;
        brcm,function = <2>; // Alt5
      };
    };
  };
};
